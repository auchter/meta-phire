## meta-phire-sunxi/conf/layer.conf
```bitbake
BBPATH .= ":${LAYERDIR}"

BBFILES += "${LAYERDIR}/recipes-*/*/*.bb \
            ${LAYERDIR}/recipes-*/*/*.bbappend"

BBFILE_COLLECTIONS += "meta-phire-sunxi-layer"
BBFILE_PATTERN_meta-phire-sunxi-layer = "^${LAYERDIR}/"
BBFILE_PRIORITY_meta-phire-sunxi-layer = "6"

LAYERSERIES_COMPAT_meta-phire-sunxi-layer = "dunfell gatesgarth hardknott"
```

## meta-phire/conf/distro/phire.conf
```bitbake
DISTRO_VERSION = "2021.08"
DISTRO_NAME = "phire"
DISTRO_CODENAME = "phire"

PACKAGE_CLASSES ?= "package_ipk"
USER_CLASSES ?= "image-buildinfo"

DISTRO_FEATURES:append = " systemd pam"
DISTRO_FEATURES:remove = " \
    3g \
    nfc \
    pci \
    x11 \
"
DISTRO_FEATURES_BACKFILL_CONSIDERED = "sysvinit"

VIRTUAL-RUNTIME_init_manager = "systemd"

TCLIBC = "glibc"

PREFERRED_VERSION_python3-gevent = "21.1.2"
PREFERRED_VERSION_python3-greenlet = "1.0.0"
PREFERRED_VERSION_python3-zopeinterface = "5.1.0"
```

## meta-phire/conf/layer.conf
```bitbake
BBPATH .= ":${LAYERDIR}"

BBFILES += "${LAYERDIR}/recipes-*/*/*.bb \
            ${LAYERDIR}/recipes-*/*/*.bbappend"

BBFILE_COLLECTIONS += "meta-phire-layer"
BBFILE_PATTERN_meta-phire-layer = "^${LAYERDIR}/"
BBFILE_PRIORITY_meta-phire-layer = "6"

LAYERSERIES_COMPAT_meta-phire-layer = "dunfell gatesgarth hardknott"
```

## meta-phire/conf/machine/phire-preamp.conf
```bitbake
MACHINEOVERRIDES = "pine-h64-model-b:${MACHINE}"

require conf/machine/pine-h64-model-b.conf

KERNEL_DEVICETREE = "allwinner/sun50i-h6-phire-preamp.dtb"
```

## meta-phire/conf/machine/pine-h64-model-b.conf
```bitbake
require conf/machine/pine-h64.conf

PREFERRED_PROVIDER_virtual/kernel = "linux-stable"
KERNEL_DEVICETREE = "allwinner/sun50i-h6-pine-h64-model-b.dtb"
MACHINE_FEATURES += "alsa bluetooth wifi usbhost"
```

## meta-phire/conf/machine/pine-h64.conf
```bitbake
require conf/machine/include/sun50i.inc

UBOOT_MACHINE = "pine_h64_defconfig"
KERNEL_DEVICETREE = "sun50i-h6-pine-h64.dtb"
PREFERRED_VERSION_linux-mainline = "5.10.%"
```

## meta-phire/conf/machine/pine64-pinecube.conf
```bitbake
require conf/machine/include/sun8i.inc

UBOOT_MACHINE = "pinecube_defconfig"
KERNEL_DEVICETREE = "sun8i-s3-pinecube.dtb"
PREFERRED_VERSION_linux-mainline = "5.10.%"
```
